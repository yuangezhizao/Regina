## platforms/Regina/sdkconfig.defaults
```kconfig
# FREERTOS
CONFIG_FREERTOS_HZ=1000

# DIAGNOSTICS
CONFIG_DIAG_USE_EXTERNAL_LOG_WRAP=y

# PARTITION TABLE
CONFIG_PARTITION_TABLE_CUSTOM=y

# I2C
CONFIG_I2C_SKIP_LEGACY_CONFLICT_CHECK=y
```

## platforms/Regina/sdkconfig.defaults.esp32c6
```kconfig
# IDF TARGET
CONFIG_IDF_TARGET="esp32c6"

# FLASH
CONFIG_ESPTOOLPY_FLASHSIZE_16MB=y
CONFIG_SPI_FLASH_SUPPORT_GD_CHIP=y
```
